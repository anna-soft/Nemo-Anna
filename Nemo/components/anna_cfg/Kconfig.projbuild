## Nemo/components/anna_cfg/Kconfig.projbuild
```kconfig
menu "Anna Config"

    config ANNA_CFG_PARTITION_NAME
        string "Partition name containing runtime Anna JSON"
        default "cfg_data"
    
    # config ANNA_FCTRY_PARTITION_NAME
    #     string "Partition name containing factory data"
    #     default "fctry_data"
    
    # config ANNA_CFG_MAX_JSON_SIZE
    #     int "Max JSON size (bytes) accepted from NVS"
    #     default 32768
    #     range 1024 65536
    
    # config ANNA_CFG_MAX_LABEL_LEN
    #     int "Max label length"
    #     default 48
    #     range 8 128
    
    endmenu
```

## Nemo/main/Kconfig.projbuild
```kconfig
menu "Example Configuration"

    config ENABLE_MEMORY_PROFILING
        bool "Enable Memory Profiling"
        default n
        help
            Enable this option to include memory profiling features in the example.
            This will allow you to monitor memory usage during runtime.

    config ANNA_CLOUD_SYNC_BASE_URL
        string "Anna cloud sync base URL"
        default "https://anna.invalid"
        help
            Fleet-global HTTPS base URL used by firmware cloud sync for
            /api/device/config/pull and /api/device/config/ack.

    config ANNA_CLOUD_SYNC_HTTP_TIMEOUT_MS
        int "Anna cloud sync HTTP timeout (ms)"
        range 1000 60000
        default 8000
        help
            Timeout for pull/ack HTTP requests.

    config ANNA_CLOUD_SYNC_TASK_STACK_BYTES
        int "Anna cloud sync task stack size (bytes)"
        range 4096 32768
        default 12288
        help
            Stack size for the dedicated anna_cloud_sync worker task.

    config ANNA_CLOUD_SYNC_CONNECT_RESPONSE_WAIT
        bool "Delay Wi-Fi ConnectNetworkResponse for Anna cloud sync"
        default y
        help
            Delay NetworkCommissioning ConnectNetworkResponse(Success)
            during commissioning until Anna cloud sync reaches a terminal
            result or the fail-open hard cap releases the response.

    config ANNA_CLOUD_SYNC_TEST_HARNESS
        bool "Enable Anna cloud sync test-only harness"
        default n
        help
            Test-only guard for branch-forcing harness used to verify
            pre-fabric cloud sync paths without changing production default
            behavior. Keep disabled for representative builds.

endmenu
```

## Nemo/sdkconfig.defaults.esp32c6
```kconfig
CONFIG_IDF_TARGET="esp32c6"

# ESP Matter Providers (fixed defaults)
# DAC provider: test (example)
CONFIG_EXAMPLE_DAC_PROVIDER=y
# CONFIG_FACTORY_PARTITION_DAC_PROVIDER is not set
# CONFIG_CUSTOM_DAC_PROVIDER is not set

# Commissionable data provider: custom
# CONFIG_FACTORY_COMMISSIONABLE_DATA_PROVIDER is not set
CONFIG_CUSTOM_COMMISSIONABLE_DATA_PROVIDER=y

# Device Instance Info provider: custom
# CONFIG_EXAMPLE_DEVICE_INSTANCE_INFO_PROVIDER is not set
# CONFIG_FACTORY_DEVICE_INSTANCE_INFO_PROVIDER is not set
CONFIG_CUSTOM_DEVICE_INSTANCE_INFO_PROVIDER=y

# Device Info provider: custom
# CONFIG_NONE_DEVICE_INFO_PROVIDER is not set
# CONFIG_FACTORY_DEVICE_INFO_PROVIDER is not set
CONFIG_CUSTOM_DEVICE_INFO_PROVIDER=y

# ESP Matter limits
CONFIG_ESP_MATTER_MAX_DYNAMIC_ENDPOINT_COUNT=16
```
